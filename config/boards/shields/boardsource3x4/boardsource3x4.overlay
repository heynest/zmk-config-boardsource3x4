/*
 * Copyright (c) 2020 The ZMK Contributors
 *
 * SPDX-License-Identifier: MIT
 */

#include <dt-bindings/zmk/matrix_transform.h>

/ {
    chosen {
        zmk,kscan = &kscan0;
    };

    kscan0: kscan {
        compatible = "zmk,kscan-gpio-matrix";
        wakeup-source;

        diode-direction = "col2row";

         row-gpios
            = <&pro_micro 18 (GPIO_ACTIVE_HIGH | GPIO_PULL_DOWN)> // 115 (nice!nano)
            , <&pro_micro 19 (GPIO_ACTIVE_HIGH | GPIO_PULL_DOWN)> // 002
            , <&pro_micro 20 (GPIO_ACTIVE_HIGH | GPIO_PULL_DOWN)> // 029
            ;

        col-gpios
            = <&pro_micro 10 GPIO_ACTIVE_HIGH> // 009
            , <&pro_micro 16 GPIO_ACTIVE_HIGH> // 010
            , <&pro_micro 14 GPIO_ACTIVE_HIGH> // 111
            ;
    };
};