## config/boards/shields/kalypso/Kconfig.defconfig
```kconfig
if SHIELD_KALYPSO_LEFT

config ZMK_KEYBOARD_NAME
    default "Kalypso"

config ZMK_SPLIT_ROLE_CENTRAL
    default y

endif

if SHIELD_KALYPSO_LEFT || SHIELD_KALYPSO_RIGHT

config ZMK_SPLIT
    default y

endif
```

## config/boards/shields/kalypso/Kconfig.shield
```kconfig
config SHIELD_KALYPSO_LEFT
    def_bool $(shields_list_contains,kalypso_left)

config SHIELD_KALYPSO_RIGHT
    def_bool $(shields_list_contains,kalypso_right)
```
